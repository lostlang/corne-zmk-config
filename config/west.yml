## config/west.yml
```yaml
manifest:
  remotes:
    - name: zmkfirmware
      url-base: https://github.com/zmkfirmware
  projects:
    - name: zmk
      remote: zmkfirmware
      revision: main
      import:
        file: app/west.yml
        name-allowlist:
          - zephyr
          - cmsis
          - hal_nordic
          - lvgl
          - mbedtls
  self:
    path: config
```
