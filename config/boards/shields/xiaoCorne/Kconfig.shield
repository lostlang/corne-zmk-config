## config/boards/shields/xiaoCorne/Kconfig.shield
```kconfig
config SHIELD_XIAOCORNE_LEFT
	def_bool $(shields_list_contains,xiaoCorne_left)

config SHIELD_XIAOCORNE_RIGHT
	def_bool $(shields_list_contains,xiaoCorne_right)
```

## config/boards/shields/xiaocorne/Kconfig.defconfig
```kconfig
if SHIELD_XIAOCORNE_LEFT

config ZMK_KEYBOARD_NAME
	default "Xiao Corne"

config ZMK_SPLIT_ROLE_CENTRAL
	default y

endif

if SHIELD_XIAOCORNE_LEFT || SHIELD_XIAOCORNE_RIGHT

config ZMK_SPLIT
	default y

endif
```

## config/boards/shields/xiaocorne/Kconfig.shield
```kconfig
config SHIELD_XIAOCORNE_LEFT
	def_bool $(shields_list_contains,xiaocorne_left)

config SHIELD_XIAOCORNE_RIGHT
	def_bool $(shields_list_contains,xiaocorne_right)
```
