#include "corne.dtsi"

&default_transform {
	col-offset = <6>;
};

&five_column_transform {
	col-offset = <6>;
};

&kscan0 {
	col-gpios
	= <&xiao_d 14 GPIO_ACTIVE_HIGH>
	, <&xiao_d 15 GPIO_ACTIVE_HIGH>
	, <&xiao_d 18 GPIO_ACTIVE_HIGH>
	, <&xiao_d 19 GPIO_ACTIVE_HIGH>
	, <&xiao_d 20 GPIO_ACTIVE_HIGH>
	, <&xiao_d 21 GPIO_ACTIVE_HIGH>
	;
};
