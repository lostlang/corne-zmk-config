/*
 * Copyright (c) 2020 The ZMK Contributors
 *
 * SPDX-License-Identifier: MIT
 */

#include <behaviors.dtsi>
#include <dt-bindings/zmk/keys.h>
#include <dt-bindings/zmk/bt.h>

#include "colemak_hd_layer.h"

/ {
	keymap {
		compatible = "zmk,keymap";

		default_layer {
			bindings = <
				ColemakL1
				ColemakL2
				ColemakL3
				ColemakL4
			>;
		};
	};
};
